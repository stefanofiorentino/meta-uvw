## conf/layer.conf
```bitbake
# We have a conf and classes directory, add to BBPATH
BBPATH .= ":${LAYERDIR}"

# We have recipes-* directories, add to BBFILES
BBFILES += "${LAYERDIR}/recipes-*/*/*.bb \
	${LAYERDIR}/recipes-*/*/*.bbappend"

BBFILE_COLLECTIONS += "uvw"
BBFILE_PATTERN_uvw = "^${LAYERDIR}/"
BBFILE_PRIORITY_uvw = "6"

LAYERSERIES_COMPAT_uvw = "zeus kirkstone langdale"
```
